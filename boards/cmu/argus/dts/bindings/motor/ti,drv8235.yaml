## boards/cmu/argus/dts/bindings/motor/ti,drv8235.yaml
```yaml
# Copyright (c) 2026 Carnegie Mellon University
# SPDX-License-Identifier: Apache-2.0

description: Texas Instruments DRV8235 magnetorquer H-bridge.

compatible: "ti,drv8235"

include: i2c-device.yaml

properties:
  vm-supply:
    type: phandle
    required: true
    description: Switched supply controlled by COIL_EN.

  max-output-microvolt:
    type: int
    required: true
    description: Maximum absolute voltage the software may command.

  coil-resistance-milliohm:
    type: int
    required: true
    description: Nominal coil resistance used to configure the inverse-resistance registers.

  imtr-full-scale-microamp:
    type: int
    default: 3700000
    description: Current represented by IMTR code 192.
```
