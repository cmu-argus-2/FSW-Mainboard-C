## boards/cmu/argus/Kconfig.argus
```kconfig
# SPDX-License-Identifier: Apache-2.0

config BOARD_ARGUS
	select SOC_RP2350B_M33_0 if BOARD_ARGUS_RP2350B_M33_0
```

## tests/drivers/adm1176/testcase.yaml
```yaml
tests:
  argus.drivers.adm1176.unit:
    platform_allow:
      - native_sim/native/64
      - qemu_cortex_m3
    integration_platforms:
      - native_sim/native/64
      - qemu_cortex_m3
    tags:
      - drivers
      - sensor
      - adm1176
```

## tests/drivers/drv8235/testcase.yaml
```yaml
tests:
  argus.drivers.drv8235.unit:
    platform_allow:
      - qemu_cortex_m3
      - native_sim/native/64
    integration_platforms:
      - qemu_cortex_m3
    tags:
      - drivers
      - actuator
      - drv8235
```

## tests/tasks/eps/testcase.yaml
```yaml
tests:
  argus.tasks.eps:
    platform_allow:
      - native_sim/native/64
      - qemu_cortex_m3
    integration_platforms:
      - native_sim/native/64
      - qemu_cortex_m3
    tags:
      - eps
      - tasks
```

## tests/tasks/eps_integration/testcase.yaml
```yaml
tests:
  argus.tasks.eps.integration:
    platform_allow:
      - native_sim/native/64
      - qemu_cortex_m3
    integration_platforms:
      - native_sim/native/64
      - qemu_cortex_m3
    tags:
      - eps
      - tasks
      - emul
```
