/*
 * MAX17205 node for the test, included inside an emulated I2C bus by each
 * board overlay in boards/. The node gets both a driver instance and a fake
 * gauge (src/max17205_emul.c), matched by compatible. The fake also answers
 * at the shadow-RAM address (0x0B), so there is no node for it.
 */

/* Configured like the Argus gauge in argus.dtsi */
fuel_gauge: max17205@36 {
	compatible = "maxim,max17205";
	reg = <0x36>;
	rsense-micro-ohms = <10000>;
};
