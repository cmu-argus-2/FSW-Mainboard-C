## CMakeLists.txt
```
cmake_minimum_required(VERSION 3.20.0)

# This test is its own Zephyr app three levels below the repo root, so point it
# at the repo's devicetree bindings (dts/bindings/) and the driver under test.
set(REPO_ROOT ${CMAKE_CURRENT_LIST_DIR}/../../..)
list(APPEND DTS_ROOT ${REPO_ROOT})

find_package(Zephyr REQUIRED HINTS $ENV{ZEPHYR_BASE})
project(max17205_test)

target_sources(app PRIVATE
        src/main.c
        src/max17205_emul.c
        ${REPO_ROOT}/src/drivers/max17205.c
)

target_include_directories(app PRIVATE
        ${REPO_ROOT}/include
)
```

## prj.conf
```kconfig
CONFIG_ZTEST=y
CONFIG_I2C=y
CONFIG_FUEL_GAUGE=y
CONFIG_EMUL=y
CONFIG_LOG=y
```

## max17205_nodes.dtsi
```dts
/*
 * MAX17205 node for the test, included inside an emulated I2C bus by each
 * board overlay in boards/. The node gets both a driver instance and a fake
 * gauge (src/max17205_emul.c), matched by compatible. The fake also answers
 * at the shadow-RAM address (0x0B), so there is no node for it.
 */

/* Configured like the Argus gauge in argus.dtsi */
fuel_gauge: max17205@36 {
	compatible = "maxim,max17205";
	reg = <0x36>;
	rsense-micro-ohms = <10000>;
};
```

## boards/native_sim.overlay
```dts
/* native_sim already has an emulated I2C controller at i2c0 */
&i2c0 {
#include "../max17205_nodes.dtsi"
};
```

## boards/native_sim_native_64.overlay
```dts
/* Zephyr only applies an overlay named for the full board target, so the 64-bit variant reuses native_sim's */
#include "native_sim.overlay"
```

## boards/qemu_cortex_m3.overlay
```dts
#include <zephyr/dt-bindings/i2c/i2c.h>

/ {
	/* qemu_cortex_m3 has no I2C node, so add an emulated controller */
	fake_i2c: i2c@100 {
		compatible = "zephyr,i2c-emul-controller";
		clock-frequency = <I2C_BITRATE_STANDARD>;
		#address-cells = <1>;
		#size-cells = <0>;
		reg = <0x100 4>;
		status = "okay";

#include "../max17205_nodes.dtsi"
	};
};
```

## src/main.c
```c
/**
 * @brief MAX17205 driver tests.
 *
 * The real driver runs unchanged against a fake gauge (max17205_emul.c) on an emulated
 * I2C bus. Each test sets the fake's registers, calls the fuel gauge API, and checks the result.
 *
 * Every register the test does not set reads back 0, so a driver that reads the wrong
 * register, or reads a shadow-RAM temperature from the main address, gets 0 and fails the
 * value check.
 */

#include <zephyr/device.h>
#include <zephyr/drivers/emul.h>
#include <zephyr/drivers/fuel_gauge.h>
#include <zephyr/ztest.h>

#include <argus/drivers/max17205.h>

#include "max17205_emul.h"

#define GAUGE_NODE DT_NODELABEL(fuel_gauge)
#define MAIN       MAX17205_MAIN_I2C_ADDR
#define SHADOW     MAX17205_SHADOW_I2C_ADDR

static const struct device *const gauge = DEVICE_DT_GET(GAUGE_NODE);
static const struct emul *const gauge_emul = EMUL_DT_GET(GAUGE_NODE);

static void max17205_before(void *fixture)
{
	ARG_UNUSED(fixture);

	max17205_emul_reset(gauge_emul);
}

ZTEST_SUITE(max17205, NULL, NULL, max17205_before, NULL, NULL);

/* Set one register, read one property, and fail the test if the read fails */
static union fuel_gauge_prop_val read_prop(uint16_t addr, uint8_t reg, uint16_t raw,
					   fuel_gauge_prop_t prop)
{
	union fuel_gauge_prop_val val = {0};

	max17205_emul_set_reg(gauge_emul, addr, reg, raw);
	zassert_ok(fuel_gauge_get_prop(gauge, prop, &val));
	return val;
}

ZTEST(max17205, test_init)
{
	zassert_true(device_is_ready(gauge));
}

/* 1/256 % per LSB */
ZTEST(max17205, test_state_of_charge)
{
	union fuel_gauge_prop_val val = read_prop(MAIN, MAX17205_EMUL_REG_REPSOC, 0x3200,
						  FUEL_GAUGE_RELATIVE_STATE_OF_CHARGE_PCT);

	zassert_equal(val.relative_state_of_charge_pct, 50);
}

/* 5 uVh / 10 mOhm = 500 uAh per LSB */
ZTEST(max17205, test_remaining_capacity)
{
	union fuel_gauge_prop_val val = read_prop(MAIN, MAX17205_EMUL_REG_REPCAP, 3000,
						  FUEL_GAUGE_REMAINING_CAPACITY_UAH);

	zassert_equal(val.remaining_capacity_uah, 1500000, "got %u", val.remaining_capacity_uah);
}

/* 1.5625 uV / 10 mOhm = 156.25 uA per LSB, signed */
ZTEST(max17205, test_current)
{
	union fuel_gauge_prop_val val;

	val = read_prop(MAIN, MAX17205_EMUL_REG_CURRENT, 256, FUEL_GAUGE_CURRENT_UA);
	zassert_equal(val.current_ua, 40000, "got %d", val.current_ua);

	/* -256: discharging */
	val = read_prop(MAIN, MAX17205_EMUL_REG_CURRENT, 0xFF00, FUEL_GAUGE_CURRENT_UA);
	zassert_equal(val.current_ua, -40000, "got %d", val.current_ua);
}

/* 1.25 mV per LSB */
ZTEST(max17205, test_pack_voltage)
{
	union fuel_gauge_prop_val val =
		read_prop(MAIN, MAX17205_EMUL_REG_VBAT, 6400, FUEL_GAUGE_VOLTAGE_UV);

	zassert_equal(val.voltage_uv, 8000000, "got %d", val.voltage_uv);
}

/* 78.125 uV per LSB */
ZTEST(max17205, test_mid_voltage)
{
	union fuel_gauge_prop_val val =
		read_prop(MAIN, MAX17205_EMUL_REG_VCELL, 40960, MAX17205_PROP_MID_VOLTAGE_UV);

	zassert_equal(val.custom_uint, 3200000, "got %u", val.custom_uint);
}

/* 16% of a full cycle per LSB */
ZTEST(max17205, test_cycle_count)
{
	union fuel_gauge_prop_val val;

	val = read_prop(MAIN, MAX17205_EMUL_REG_CYCLES, 100, FUEL_GAUGE_CYCLE_COUNT);
	zassert_equal(val.cycle_count, 16, "got %u", val.cycle_count);

	/* Full scale */
	val = read_prop(MAIN, MAX17205_EMUL_REG_CYCLES, 0xFFFF, FUEL_GAUGE_CYCLE_COUNT);
	zassert_equal(val.cycle_count, 10485, "got %u", val.cycle_count);
}

/* 5.625 s per LSB */
ZTEST(max17205, test_runtime_to_empty)
{
	union fuel_gauge_prop_val val =
		read_prop(MAIN, MAX17205_EMUL_REG_TTE, 640, FUEL_GAUGE_RUNTIME_TO_EMPTY_MINS);

	zassert_equal(val.runtime_to_empty_mins, 60, "got %u", val.runtime_to_empty_mins);
}

ZTEST(max17205, test_runtime_to_full)
{
	union fuel_gauge_prop_val val =
		read_prop(MAIN, MAX17205_EMUL_REG_TTF, 320, FUEL_GAUGE_RUNTIME_TO_FULL_MINS);

	zassert_equal(val.runtime_to_full_mins, 30, "got %u", val.runtime_to_full_mins);
}

/* TimerH: 3.2 h per LSB */
ZTEST(max17205, test_time_since_powerup)
{
	union fuel_gauge_prop_val val;

	val = read_prop(MAIN, MAX17205_EMUL_REG_TIMERH, 1, MAX17205_PROP_TIME_PWRUP_S);
	zassert_equal(val.custom_uint, 11520, "got %u", val.custom_uint);

	/* Full scale, about 24 years, still fits in 32 bits */
	val = read_prop(MAIN, MAX17205_EMUL_REG_TIMERH, 0xFFFF, MAX17205_PROP_TIME_PWRUP_S);
	zassert_equal(val.custom_uint, 754963200, "got %u", val.custom_uint);
}

/* 1/256 degC per LSB, signed, reported in 0.1 K */
ZTEST(max17205, test_temperature)
{
	union fuel_gauge_prop_val val;

	/* 25 degC */
	val = read_prop(MAIN, MAX17205_EMUL_REG_TEMP, 0x1900, FUEL_GAUGE_TEMPERATURE_DK);
	zassert_equal(val.temperature_dk, 2982, "got %u", val.temperature_dk);

	/* -10 degC */
	val = read_prop(MAIN, MAX17205_EMUL_REG_TEMP, 0xF600, FUEL_GAUGE_TEMPERATURE_DK);
	zassert_equal(val.temperature_dk, 2632, "got %u", val.temperature_dk);
}

/* Shadow RAM temperatures are already 0.1 K */
ZTEST(max17205, test_temperature_ain1)
{
	union fuel_gauge_prop_val val =
		read_prop(SHADOW, MAX17205_EMUL_REG_TEMP1, 2982, MAX17205_PROP_TEMP_AIN1_DK);

	zassert_equal(val.custom_int, 2982, "got %d", val.custom_int);
}

ZTEST(max17205, test_temperature_ain2)
{
	union fuel_gauge_prop_val val =
		read_prop(SHADOW, MAX17205_EMUL_REG_TEMP2, 2932, MAX17205_PROP_TEMP_AIN2_DK);

	zassert_equal(val.custom_int, 2932, "got %d", val.custom_int);
}

ZTEST(max17205, test_temperature_die)
{
	union fuel_gauge_prop_val val =
		read_prop(SHADOW, MAX17205_EMUL_REG_INTTEMP, 3032, MAX17205_PROP_TEMP_DIE_DK);

	zassert_equal(val.custom_int, 3032, "got %d", val.custom_int);
}

ZTEST(max17205, test_unsupported_property)
{
	union fuel_gauge_prop_val val;

	zassert_equal(fuel_gauge_get_prop(gauge, FUEL_GAUGE_DESIGN_CAPACITY, &val), -ENOTSUP);
}

ZTEST(max17205, test_bus_error)
{
	union fuel_gauge_prop_val val;

	max17205_emul_set_nack(gauge_emul, true);
	zassert_equal(fuel_gauge_get_prop(gauge, FUEL_GAUGE_VOLTAGE_UV, &val), -EIO);
}

/* Reset sets POR_CMD (bit 0) in Config2 */
ZTEST(max17205, test_reset)
{
	zassert_ok(max17205_reset(gauge));

	uint16_t config2 = max17205_emul_get_reg(gauge_emul, MAIN, MAX17205_EMUL_REG_CONFIG2);

	zassert_equal(config2, 0x0001, "Config2 is 0x%04x", config2);
}
```

## src/max17205_emul.c
```c
/**
 * @brief Fake MAX17205 for tests.
 *
 * Holds the gauge's 16-bit registers and answers I2C transfers the way the real part does:
 * the first byte written sets the register pointer, further bytes are written LSB first,
 * and reads return registers LSB first. The pointer steps to the next register after each one.
 *
 * The real chip answers at two addresses: the main register block at 0x36 and shadow RAM at
 * 0x0B. The devicetree node only registers 0x36 with the emulated bus, so init registers 0x0B
 * by hand, and the transfer picks the register file from the address it was sent to.
 */

#define DT_DRV_COMPAT maxim_max17205

#include <string.h>
#include <zephyr/device.h>
#include <zephyr/drivers/emul.h>
#include <zephyr/drivers/i2c.h>
#include <zephyr/drivers/i2c_emul.h>

#include <argus/drivers/max17205.h>

#include "max17205_emul.h"

#define MAX17205_EMUL_NUM_REGS 256

struct max17205_emul_data {
	uint16_t main[MAX17205_EMUL_NUM_REGS];
	uint16_t shadow[MAX17205_EMUL_NUM_REGS];
	uint8_t reg_ptr;
	bool nack;
	/* Puts this emulator on the bus a second time, at the shadow-RAM address */
	struct i2c_emul shadow_bus;
};

static uint16_t *max17205_emul_regs(struct max17205_emul_data *data, uint16_t addr)
{
	__ASSERT(addr == MAX17205_MAIN_I2C_ADDR || addr == MAX17205_SHADOW_I2C_ADDR,
		 "no MAX17205 register file at 0x%02x", addr);
	return addr == MAX17205_SHADOW_I2C_ADDR ? data->shadow : data->main;
}

void max17205_emul_set_reg(const struct emul *target, uint16_t addr, uint8_t reg, uint16_t val)
{
	max17205_emul_regs(target->data, addr)[reg] = val;
}

uint16_t max17205_emul_get_reg(const struct emul *target, uint16_t addr, uint8_t reg)
{
	return max17205_emul_regs(target->data, addr)[reg];
}

void max17205_emul_set_nack(const struct emul *target, bool nack)
{
	struct max17205_emul_data *data = target->data;

	data->nack = nack;
}

void max17205_emul_reset(const struct emul *target)
{
	struct max17205_emul_data *data = target->data;

	memset(data->main, 0, sizeof(data->main));
	memset(data->shadow, 0, sizeof(data->shadow));
	data->reg_ptr = 0;
	data->nack = false;
}

static int max17205_emul_transfer(const struct emul *target, struct i2c_msg *msgs, int num_msgs,
				  int addr)
{
	struct max17205_emul_data *data = target->data;
	uint16_t *regs = max17205_emul_regs(data, addr);
	bool have_ptr = false;
	bool have_lsb = false;
	uint8_t lsb = 0;

	if (data->nack) {
		return -EIO;
	}

	/* The write state carries across messages, in case a write is split over several */
	for (int i = 0; i < num_msgs; i++) {
		struct i2c_msg *msg = &msgs[i];
		bool is_read = (msg->flags & I2C_MSG_RW_MASK) == I2C_MSG_READ;

		for (uint32_t j = 0; j < msg->len; j++) {
			if (!is_read && !have_ptr) {
				data->reg_ptr = msg->buf[j];
				have_ptr = true;
				continue;
			}

			if (is_read) {
				uint16_t reg = regs[data->reg_ptr];

				msg->buf[j] = (j % 2 == 0) ? reg & 0xFF : reg >> 8;
				if (j % 2 == 1) {
					data->reg_ptr++;
				}
			} else if (!have_lsb) {
				lsb = msg->buf[j];
				have_lsb = true;
			} else {
				regs[data->reg_ptr++] = (msg->buf[j] << 8) | lsb;
				have_lsb = false;
			}
		}
	}

	return 0;
}

static const struct i2c_emul_api max17205_emul_api = {
	.transfer = max17205_emul_transfer,
};

/* Runs when the emulated I2C controller starts, before the driver's init */
static int max17205_emul_init(const struct emul *target, const struct device *parent)
{
	struct max17205_emul_data *data = target->data;

	max17205_emul_reset(target);

	data->shadow_bus.target = target;
	data->shadow_bus.api = &max17205_emul_api;
	data->shadow_bus.addr = MAX17205_SHADOW_I2C_ADDR;

	return i2c_emul_register(parent, &data->shadow_bus);
}

#define MAX17205_EMUL_DEFINE(inst)                                                           \
	static struct max17205_emul_data max17205_emul_data_##inst;                          \
	EMUL_DT_INST_DEFINE(inst, max17205_emul_init, &max17205_emul_data_##inst, NULL,      \
			    &max17205_emul_api, NULL);

DT_INST_FOREACH_STATUS_OKAY(MAX17205_EMUL_DEFINE)
```

## src/max17205_emul.h
```c
/**
 * @brief Fake MAX17205 for tests: two register files the driver reaches over the emulated I2C bus.
 */

#ifndef MAX17205_EMUL_H_
#define MAX17205_EMUL_H_

#include <stdbool.h>
#include <stdint.h>
#include <zephyr/drivers/emul.h>

/* Main register block, I2C address 0x36 (the driver keeps its copy private) */
#define MAX17205_EMUL_REG_REPCAP  0x05
#define MAX17205_EMUL_REG_REPSOC  0x06
#define MAX17205_EMUL_REG_TEMP    0x08
#define MAX17205_EMUL_REG_VCELL   0x09
#define MAX17205_EMUL_REG_CURRENT 0x0A
#define MAX17205_EMUL_REG_TTE     0x11
#define MAX17205_EMUL_REG_CYCLES  0x17
#define MAX17205_EMUL_REG_TTF     0x20
#define MAX17205_EMUL_REG_CONFIG2 0xBB
#define MAX17205_EMUL_REG_TIMERH  0xBE
#define MAX17205_EMUL_REG_VBAT    0xDA

/* Shadow RAM, I2C address 0x0B */
#define MAX17205_EMUL_REG_TEMP1   0x34
#define MAX17205_EMUL_REG_INTTEMP 0x35
#define MAX17205_EMUL_REG_TEMP2   0x3B

/* Which register file: MAX17205_MAIN_I2C_ADDR or MAX17205_SHADOW_I2C_ADDR */
void max17205_emul_set_reg(const struct emul *target, uint16_t addr, uint8_t reg, uint16_t val);
uint16_t max17205_emul_get_reg(const struct emul *target, uint16_t addr, uint8_t reg);

/* Fail every transfer with -EIO, as if the gauge stopped answering */
void max17205_emul_set_nack(const struct emul *target, bool nack);

/* Zero both register files and clear the NACK */
void max17205_emul_reset(const struct emul *target);

#endif /* MAX17205_EMUL_H_ */
```
