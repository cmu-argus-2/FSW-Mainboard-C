## CMakeLists.txt
```
cmake_minimum_required(VERSION 3.20.0)

# This test is its own Zephyr app three levels below the repo root, so point it
# at the repo's devicetree bindings (dts/bindings/) and the driver under test.
set(REPO_ROOT ${CMAKE_CURRENT_LIST_DIR}/../../..)
list(APPEND DTS_ROOT ${REPO_ROOT})

find_package(Zephyr REQUIRED HINTS $ENV{ZEPHYR_BASE})
project(opt4003_test)

target_sources(app PRIVATE
        src/main.c
        src/opt4003_emul.c
        ${REPO_ROOT}/src/drivers/opt4003.c
)

target_include_directories(app PRIVATE
        ${REPO_ROOT}/include
)
```

## prj.conf
```kconfig
CONFIG_ZTEST=y
CONFIG_I2C=y
CONFIG_SENSOR=y
CONFIG_EMUL=y
CONFIG_LOG=y
```

## opt4003_nodes.dtsi
```dts
/*
 * OPT4003 nodes for the test, included inside an emulated I2C bus by each
 * board overlay in boards/. Each node gets both a driver instance and a fake
 * sensor (src/opt4003_emul.c), matched by compatible.
 */

/* Configured like the Argus sensors in argus.dtsi */
light: opt4003@44 {
	compatible = "ti,opt4003";
	reg = <0x44>;
	conversion-time = <0>;
};

/* Not initialized at boot, so a test can choose its device ID first and then call device_init() */
light_deferred: opt4003@45 {
	compatible = "ti,opt4003";
	reg = <0x45>;
	zephyr,deferred-init;
};
```

## boards/native_sim_native_64.overlay
```dts
/* native_sim already has an emulated I2C controller at i2c0 */
&i2c0 {
#include "../opt4003_nodes.dtsi"
};
```

## boards/qemu_cortex_m3.overlay
```dts
#include <zephyr/dt-bindings/i2c/i2c.h>

/ {
	/* qemu_cortex_m3 has no I2C node, so add an emulated controller */
	fake_i2c: i2c@100 {
		compatible = "zephyr,i2c-emul-controller";
		clock-frequency = <I2C_BITRATE_STANDARD>;
		#address-cells = <1>;
		#size-cells = <0>;
		reg = <0x100 4>;
		status = "okay";

#include "../opt4003_nodes.dtsi"
	};
};
```

## src/main.c
```c
/**
 * @brief OPT4003 driver tests.
 *
 * The real driver runs unchanged against a fake sensor (opt4003_emul.c) on an emulated
 * I2C bus. Each test sets the fake's registers, calls the sensor API, and checks the result.
 */

#include <zephyr/device.h>
#include <zephyr/drivers/emul.h>
#include <zephyr/drivers/sensor.h>
#include <zephyr/ztest.h>

#include <argus/drivers/opt4003.h>

#include "opt4003_emul.h"

#define LIGHT_NODE          DT_NODELABEL(light)
#define LIGHT_DEFERRED_NODE DT_NODELABEL(light_deferred)

static const struct device *const light = DEVICE_DT_GET(LIGHT_NODE);
static const struct emul *const light_emul = EMUL_DT_GET(LIGHT_NODE);

/* Clear what tests change. CONFIGURATION and DEVICE_ID keep the values boot left them with. */
static void opt4003_before(void *fixture)
{
	ARG_UNUSED(fixture);

	opt4003_emul_set_reg(light_emul, OPT4003_EMUL_REG_RESULT_MSB_CH0, 0);
	opt4003_emul_set_reg(light_emul, OPT4003_EMUL_REG_RESULT_LSB_CH0, 0);
	opt4003_emul_set_reg(light_emul, OPT4003_EMUL_REG_FLAGS, 0);
}

ZTEST_SUITE(opt4003, NULL, NULL, opt4003_before, NULL, NULL);

/* Boot ran opt4003_init(): the ID check passed and CONFIGURATION was built from devicetree */
ZTEST(opt4003, test_init_writes_config)
{
	uint16_t config = opt4003_emul_get_reg(light_emul, OPT4003_EMUL_REG_CONFIGURATION);

	zassert_true(device_is_ready(light));

	/* auto range, 600 us conversion, continuous mode, latched window */
	zassert_equal(config, 0x3038, "CONFIGURATION is 0x%04x", config);
}

/* exponent 3, mantissa 0x12345, counter 0, CRC 0x3 -> 596520 ADC codes -> 319.1382 lux */
ZTEST(opt4003, test_lux)
{
	struct sensor_value val;

	opt4003_emul_set_reg(light_emul, OPT4003_EMUL_REG_RESULT_MSB_CH0, 0x3123);
	opt4003_emul_set_reg(light_emul, OPT4003_EMUL_REG_RESULT_LSB_CH0, 0x4503);
	opt4003_emul_set_reg(light_emul, OPT4003_EMUL_REG_FLAGS, BIT(OPT4003_FLAG_CONVERSION_READY));

	zassert_ok(sensor_sample_fetch(light));
	zassert_ok(sensor_channel_get(light, SENSOR_CHAN_LIGHT, &val));
	zassert_equal(val.val1, 319, "val1 is %d", val.val1);
	zassert_equal(val.val2, 138200, "val2 is %d", val.val2);
}

ZTEST(opt4003, test_bad_crc)
{
	opt4003_emul_set_reg(light_emul, OPT4003_EMUL_REG_RESULT_MSB_CH0, 0x3123);
	opt4003_emul_set_reg(light_emul, OPT4003_EMUL_REG_RESULT_LSB_CH0, 0x4504);
	opt4003_emul_set_reg(light_emul, OPT4003_EMUL_REG_FLAGS, BIT(OPT4003_FLAG_CONVERSION_READY));

	int ret = sensor_sample_fetch(light);

	zassert_equal(ret, -EIO);
}

ZTEST(opt4003, test_not_ready)
{
	opt4003_emul_set_reg(light_emul, OPT4003_EMUL_REG_RESULT_MSB_CH0, 0x3123);
	opt4003_emul_set_reg(light_emul, OPT4003_EMUL_REG_RESULT_LSB_CH0, 0x4504);
	opt4003_emul_set_reg(light_emul, OPT4003_EMUL_REG_FLAGS, 0);

	int ret = sensor_sample_fetch(light);

	zassert_equal(ret, -ETIMEDOUT);
}

ZTEST(opt4003, test_wrong_channel)
{
	int ret = sensor_sample_fetch_chan(light, SENSOR_CHAN_ACCEL_XYZ);
	zassert_equal(ret, -ENOTSUP);
	
	struct sensor_value val;
	ret = sensor_channel_get(light, SENSOR_CHAN_ACCEL_X, &val);
	zassert_equal(ret, -ENOTSUP);
}

ZTEST(opt4003, test_flags)
{
	opt4003_emul_set_reg(light_emul, OPT4003_EMUL_REG_RESULT_MSB_CH0, 0x3123);
	opt4003_emul_set_reg(light_emul, OPT4003_EMUL_REG_RESULT_LSB_CH0, 0x4503);
	opt4003_emul_set_reg(light_emul, OPT4003_EMUL_REG_FLAGS, BIT(OPT4003_FLAG_CONVERSION_READY) | BIT(OPT4003_FLAG_OVERLOAD));
	zassert_ok(sensor_sample_fetch(light));

	uint16_t flags = opt4003_get_flags(light);
	zassert_true(flags & BIT(OPT4003_FLAG_OVERLOAD));
}

ZTEST(opt4003, test_bad_device_id)
{
	const struct device *dev = DEVICE_DT_GET(LIGHT_DEFERRED_NODE);
	const struct emul *emul = EMUL_DT_GET(LIGHT_DEFERRED_NODE);

	opt4003_emul_set_reg(emul, OPT4003_EMUL_REG_DEVICE_ID, 0x0121);
	int ret = device_init(dev);
	zassert_equal(ret, -ENODEV);

	bool ret1 = device_is_ready(dev);
	zassert_equal(ret1, false);
}
```

## src/opt4003_emul.c
```c
/**
 * @brief Fake OPT4003 for tests.
 *
 * Holds the sensor's 16-bit registers and answers I2C transfers the way the real part does:
 * the first byte written sets the register pointer, further bytes are written MSB first,
 * and reads return registers MSB first. The pointer steps to the next register after each
 * one, so the driver's 4-byte result read gets RESULT_MSB_CH0 then RESULT_LSB_CH0.
 */

#define DT_DRV_COMPAT ti_opt4003

#include <string.h>
#include <zephyr/device.h>
#include <zephyr/drivers/emul.h>
#include <zephyr/drivers/i2c.h>
#include <zephyr/drivers/i2c_emul.h>

#include "opt4003_emul.h"

struct opt4003_emul_data {
	uint16_t regs[OPT4003_EMUL_NUM_REGS];
	uint8_t reg_ptr;
};

void opt4003_emul_set_reg(const struct emul *target, uint8_t reg, uint16_t val)
{
	struct opt4003_emul_data *data = target->data;

	__ASSERT_NO_MSG(reg < OPT4003_EMUL_NUM_REGS);
	data->regs[reg] = val;
}

uint16_t opt4003_emul_get_reg(const struct emul *target, uint8_t reg)
{
	struct opt4003_emul_data *data = target->data;

	__ASSERT_NO_MSG(reg < OPT4003_EMUL_NUM_REGS);
	return data->regs[reg];
}

static int opt4003_emul_transfer(const struct emul *target, struct i2c_msg *msgs, int num_msgs,
				 int addr)
{
	struct opt4003_emul_data *data = target->data;
	bool have_ptr = false;
	bool have_msb = false;
	uint8_t msb = 0;

	ARG_UNUSED(addr);

	/* i2c_burst_write_dt() sends the register and the value as two write messages, so the
	 * write state carries across messages within one transfer.
	 */
	for (int i = 0; i < num_msgs; i++) {
		struct i2c_msg *msg = &msgs[i];
		bool is_read = (msg->flags & I2C_MSG_RW_MASK) == I2C_MSG_READ;

		for (uint32_t j = 0; j < msg->len; j++) {
			if (!is_read && !have_ptr) {
				data->reg_ptr = msg->buf[j];
				have_ptr = true;
				continue;
			}

			if (data->reg_ptr >= OPT4003_EMUL_NUM_REGS) {
				return -EIO;
			}

			if (is_read) {
				uint16_t reg = data->regs[data->reg_ptr];

				msg->buf[j] = (j % 2 == 0) ? reg >> 8 : reg & 0xFF;
				if (j % 2 == 1) {
					data->reg_ptr++;
				}
			} else if (!have_msb) {
				msb = msg->buf[j];
				have_msb = true;
			} else {
				data->regs[data->reg_ptr++] = (msb << 8) | msg->buf[j];
				have_msb = false;
			}
		}
	}

	return 0;
}

static const struct i2c_emul_api opt4003_emul_api = {
	.transfer = opt4003_emul_transfer,
};

/* Runs when the emulated I2C controller starts, before the driver's init */
static int opt4003_emul_init(const struct emul *target, const struct device *parent)
{
	struct opt4003_emul_data *data = target->data;

	ARG_UNUSED(parent);

	memset(data->regs, 0, sizeof(data->regs));
	data->regs[OPT4003_EMUL_REG_DEVICE_ID] = OPT4003_EMUL_DEVICE_ID;
	data->reg_ptr = 0;

	return 0;
}

#define OPT4003_EMUL_DEFINE(inst)                                                            \
	static struct opt4003_emul_data opt4003_emul_data_##inst;                            \
	EMUL_DT_INST_DEFINE(inst, opt4003_emul_init, &opt4003_emul_data_##inst, NULL,        \
			    &opt4003_emul_api, NULL);

DT_INST_FOREACH_STATUS_OKAY(OPT4003_EMUL_DEFINE)
```

## src/opt4003_emul.h
```c
/**
 * @brief Fake OPT4003 for tests: a register file the driver reaches over the emulated I2C bus.
 */

#ifndef OPT4003_EMUL_H_
#define OPT4003_EMUL_H_

#include <stdint.h>
#include <zephyr/drivers/emul.h>

/* Register map, as described on page 25 of the datasheet (the driver keeps its copy private) */
#define OPT4003_EMUL_REG_RESULT_MSB_CH0 0x00
#define OPT4003_EMUL_REG_RESULT_LSB_CH0 0x01
#define OPT4003_EMUL_REG_CONFIGURATION  0x0A
#define OPT4003_EMUL_REG_FLAGS          0x0C
#define OPT4003_EMUL_REG_DEVICE_ID      0x11
#define OPT4003_EMUL_NUM_REGS           0x12

/* What DEVICE_ID holds after reset: DIDL = 0, DIDH = 0x221 */
#define OPT4003_EMUL_DEVICE_ID 0x0221

void opt4003_emul_set_reg(const struct emul *target, uint8_t reg, uint16_t val);
uint16_t opt4003_emul_get_reg(const struct emul *target, uint8_t reg);

#endif /* OPT4003_EMUL_H_ */
```
